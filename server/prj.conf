## CMakeLists.txt
```
cmake_minimum_required(VERSION 3.20.0)
find_package(Zephyr REQUIRED HINTS $ENV{ZEPHYR_BASE})

project(coap-client-server)

target_sources(app PRIVATE 
    src/main.c
    src/print_service.c
    src/coap_event_handler.c
)

target_include_directories(app PRIVATE
    src 
    ${ZEPHYR_BASE}/subsys/net/ip
)

zephyr_linker_sources(DATA_SECTIONS sections-ram.ld)
```

## prj.conf
```kconfig
# Logging
CONFIG_LOG=y
CONFIG_LOG_MODE_DEFERRED=y
CONFIG_LOG_PROCESS_THREAD=y
CONFIG_LOG_PROCESS_THREAD_SLEEP_MS=20

# Shell
# CONFIG_SHELL=y
# CONFIG_SHELL_PROMPT_UART="server$ "
# CONFIG_NET_SHELL=y
# CONFIG_COAP_SERVER_SHELL=y

# IEEE 802.15.4
CONFIG_IEEE802154=y
CONFIG_IEEE802154_NRF5=y

# Network
CONFIG_NETWORKING=y
CONFIG_NET_LOG=n
CONFIG_NET_UDP=y
CONFIG_NET_L2_IEEE802154=y
CONFIG_NET_L2_IEEE802154_LOG_LEVEL_DBG=n
# IPv6 Support
CONFIG_NET_IPV6=y
CONFIG_NET_IPV6_MLD=y
CONFIG_NET_CONFIG_NEED_IPV6=y
CONFIG_NET_CONFIG_MY_IPV6_ADDR="2001:db8::1"
CONFIG_NET_IF_MCAST_IPV6_ADDR_COUNT=6

# Sockets
CONFIG_NET_SOCKETS=y
CONFIG_NET_SOCKETS_OFFLOAD=y
CONFIG_NET_SOCKETS_POSIX_NAMES=y

# CoAP
CONFIG_COAP=y
CONFIG_COAP_SERVER=y
CONFIG_COAP_SERVER_WELL_KNOWN_CORE=y
CONFIG_COAP_WELL_KNOWN_BLOCK_WISE=n

# Settings
CONFIG_NET_CONFIG_SETTINGS=y

# Events
CONFIG_NET_MGMT=y
CONFIG_NET_MGMT_EVENT=y
CONFIG_NET_MGMT_EVENT_INFO=y
```

## src/main.c
```c
/*
 * Copyright (c) 2024 Albin Hjalmas (albin@bitman.se)
 *
 * SPDX-License-Identifier: Apache-2.0
 */

#include <zephyr/logging/log.h>
LOG_MODULE_REGISTER(coap_server, LOG_LEVEL_DBG);

#include <zephyr/net/coap.h>
#include <zephyr/net/coap_link_format.h>
#include <zephyr/net/coap_service.h>
#include <zephyr/net/net_ip.h>
#include <zephyr/net/socket.h>
#include <zephyr/kernel.h>
#include <zephyr/net/net_if.h>

#ifdef CONFIG_NET_IPV6
#include "ipv6.h"
#include "net_private.h"
#endif

#include "coap_event_handler.h"
#include "print_service.h"

static const uint16_t coap_port = 5683;
static const uint16_t multicast_port = 5685; // Different port for multicast group

#define ALL_NODES_LOCAL_COAP_MCAST                                                                 \
    {                                                                                              \
        {                                                                                          \
            {                                                                                      \
                0xff, 0x02, 0, 0, 0, 0, 0, 0, 0, 0, 0, 0, 0, 0, 0, 0xfd                            \
            }                                                                                      \
        }                                                                                          \
    }

#define LINE_NODE_MCAST_ADDR                                                                       \
    {                                                                                              \
        {                                                                                          \
            {                                                                                      \
                0xff, 0x02, 0, 0, 0, 0, 0, 0, 0, 0, 0, 0, 0, 0, 0, 0x02                            \
            }                                                                                      \
        }                                                                                          \
    }

#define STACK_SIZE 2048
#define PRIORITY 7

K_THREAD_STACK_DEFINE(thread_stack, STACK_SIZE);
struct k_thread thread_data;

static int join_multicast_group(struct in6_addr *mcast_addr)
{
    struct net_if_mcast_addr *if_maddr;
    struct net_if *iface;
    char addr_str[NET_IPV6_ADDR_LEN];

    iface = net_if_get_default();
    if (!iface) {
        LOG_ERR("Could not get the default interface");
        return -ENOENT;
    }

    if (!net_if_is_up(iface)) {
        LOG_ERR("Default interface is down");
        return -ENETDOWN;
    }

    net_addr_ntop(AF_INET6, mcast_addr, addr_str, sizeof(addr_str));
    LOG_DBG("Joining multicast group %s", addr_str);

    if_maddr = net_if_ipv6_maddr_add(iface, mcast_addr);
    if (!if_maddr) {
        LOG_ERR("Could not add multicast address %s to interface", addr_str);
        return -EINVAL;
    }

    if_maddr->is_joined = true;
    LOG_DBG("Joined multicast group %s", addr_str);

    return 0;
}

static int join_multicast_groups(void)
{
    static struct in6_addr all_nodes_local_coap_mcast = ALL_NODES_LOCAL_COAP_MCAST;
    static struct in6_addr line_node_mcast_addr = LINE_NODE_MCAST_ADDR;

    int ret;

    ret = join_multicast_group(&all_nodes_local_coap_mcast);
    if (ret < 0) {
        return ret;
    }

    ret = join_multicast_group(&line_node_mcast_addr);
    if (ret < 0) {
        return ret;
    }

    return 0;
}

static void process_received_message(int sock)
{
    struct sockaddr_in6 src_addr;
    socklen_t addr_len = sizeof(src_addr);
    char buffer[128];
    int len;

    while (1) {
        len = recvfrom(sock, buffer, sizeof(buffer), 0, (struct sockaddr *)&src_addr, &addr_len);
        if (len < 0) {
            LOG_ERR("Failed to receive data");
            break;
        }

        buffer[len] = '\0'; // Ensure the received data is null-terminated
        LOG_INF("Received data: %s", buffer);
    }
}

int main(void)
{
    LOG_DBG("Starting CoAP server");

    int multicast_sock;

    coap_event_handler_init();

    int ret = join_multicast_groups();
    if (ret < 0) {
        LOG_ERR("Failed to join multicast groups (err %d)", ret);
        return ret;
    }

    multicast_sock = socket(AF_INET6, SOCK_DGRAM, IPPROTO_UDP);
    if (multicast_sock < 0) {
        LOG_ERR("Failed to create multicast socket: %d", errno);
        return -errno;
    }

    struct sockaddr_in6 bind_addr = {
        .sin6_family = AF_INET6,
        .sin6_addr = IN6ADDR_ANY_INIT,
        .sin6_port = htons(multicast_port), // Use a different port for multicast
    };

    ret = bind(multicast_sock, (struct sockaddr *)&bind_addr, sizeof(bind_addr));
    if (ret < 0) {
        LOG_ERR("Failed to bind multicast socket: %d", errno);
        close(multicast_sock);
        return -errno;
    }

    k_thread_create(&thread_data, thread_stack, K_THREAD_STACK_SIZEOF(thread_stack),
                    (k_thread_entry_t)process_received_message, (void *)(intptr_t)multicast_sock,
                    NULL, NULL, PRIORITY, 0, K_NO_WAIT);

    k_thread_name_set(&thread_data, "multicast_recv_thread");

    int rc = print_service_init();
    if (rc < 0) {
        LOG_ERR("Failed to initialize print service (err %d)", rc);
        return rc;
    }

    return 0;
}

#ifdef CONFIG_NET_IPV6
COAP_SERVICE_DEFINE(coap_server, NULL, &coap_port, COAP_SERVICE_AUTOSTART);
#else
#error "IPv4 not supported"
#endif /* CONFIG_NET_IPV6 */
```

## src/coap_event_handler.c
```c
/*
 * Copyright (c) 2024 Albin Hjalmas (albin@bitman.se)
 *
 * SPDX-License-Identifier: Apache-2.0
 */

#include <zephyr/logging/log.h>
LOG_MODULE_REGISTER(coap_event_handler, LOG_LEVEL_INF);

#include <zephyr/net/coap_mgmt.h>
#include <zephyr/net/coap_service.h>

#define COAP_EVENTS_SET                                                                            \
    (NET_EVENT_COAP_OBSERVER_ADDED | NET_EVENT_COAP_OBSERVER_REMOVED |                             \
     NET_EVENT_COAP_SERVICE_STARTED | NET_EVENT_COAP_SERVICE_STOPPED)

static void coap_event_handler_cb(struct net_mgmt_event_callback *cb, uint32_t mgmt_event,
                                  struct net_if *iface)
{
    ARG_UNUSED(iface);

    switch (mgmt_event) {
    case NET_EVENT_COAP_OBSERVER_ADDED:
        LOG_INF("CoAP observer added");
        break;
    case NET_EVENT_COAP_OBSERVER_REMOVED:
        LOG_INF("CoAP observer removed");
        break;
    case NET_EVENT_COAP_SERVICE_STARTED:
        if (cb->info != NULL && cb->info_length == sizeof(struct net_event_coap_service)) {
            struct net_event_coap_service *net_event = cb->info;

            LOG_INF("CoAP service %s started", net_event->service->name);
        } else {
            LOG_INF("CoAP service started");
        }
        break;
    case NET_EVENT_COAP_SERVICE_STOPPED:
        if (cb->info != NULL && cb->info_length == sizeof(struct net_event_coap_service)) {
            struct net_event_coap_service *net_event = cb->info;

            LOG_INF("CoAP service %s stopped", net_event->service->name);
        } else {
            LOG_INF("CoAP service stopped");
        }
        break;
    default:
        LOG_WRN("Unknown CoAP event %d", mgmt_event);
        break;
    }
}

static struct net_mgmt_event_callback coap_event_handler;

void coap_event_handler_init(void)
{
    net_mgmt_init_event_callback(&coap_event_handler, coap_event_handler_cb, COAP_EVENTS_SET);
    net_mgmt_add_event_callback(&coap_event_handler);

    LOG_INF("CoAP event handler initialized");
}
```

## src/coap_event_handler.h
```c
/*
 * Copyright (c) 2024 Albin Hjalmas (albin@bitman.se)
 *
 * SPDX-License-Identifier: Apache-2.0
 */
#ifndef COAP_EVENT_HANDLER_H
#define COAP_EVENT_HANDLER_H

void coap_event_handler_init(void);

#endif // COAP_EVENT_HANDLER_H
```

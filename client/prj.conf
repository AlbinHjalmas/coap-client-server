## CMakeLists.txt
```
cmake_minimum_required(VERSION 3.20.0)
find_package(Zephyr REQUIRED HINTS $ENV{ZEPHYR_BASE})

project(coap-client-server)

target_sources(app PRIVATE 
    src/main.c
    src/coap_client.c
    src/server_proxy.c
    src/print_service.c
)

target_include_directories(app PRIVATE
    src 
    ${ZEPHYR_BASE}/subsys/net/ip
)

zephyr_linker_sources(DATA_SECTIONS sections-ram.ld)
```

## prj.conf
```kconfig
# Zephyr
CONFIG_HEAP_MEM_POOL_SIZE=2048
CONFIG_REQUIRES_FULL_LIBC=n
CONFIG_MAIN_STACK_SIZE=4096

# Logging
CONFIG_LOG=y
CONFIG_LOG_MODE_DEFERRED=y
CONFIG_LOG_PROCESS_THREAD=y
CONFIG_LOG_PROCESS_THREAD_SLEEP_MS=20
CONFIG_LOG_PROCESS_THREAD_STACK_SIZE=2048
CONFIG_PRINTK=y
CONFIG_NET_LOG=y

# IEEE 802.15.4
CONFIG_IEEE802154=y
CONFIG_IEEE802154_NRF5=y

# Network
CONFIG_NETWORKING=y
CONFIG_NET_IPV6=y
CONFIG_NET_UDP=y
CONFIG_NET_L2_IEEE802154=y
CONFIG_NET_L2_IEEE802154_LOG_LEVEL_DBG=n
CONFIG_NET_DRIVERS=y
CONFIG_NET_LOOPBACK=y
CONFIG_NET_CONFIG_SETTINGS=y
CONFIG_NET_CONFIG_NEED_IPV6=y
CONFIG_NET_CONFIG_MY_IPV6_ADDR="2001:db8::2"
CONFIG_NET_CONNECTION_MANAGER=y
CONFIG_NET_IF_MCAST_IPV6_ADDR_COUNT=5
CONFIG_POSIX_MAX_FDS=6

# Sockets
CONFIG_NET_SOCKETS=y
CONFIG_NET_SOCKETS_POSIX_NAMES=y
CONFIG_NET_SOCKETS_POLL_MAX=4

# CoAP Client
CONFIG_COAP=y
CONFIG_COAP_CLIENT=y
CONFIG_COAP_CLIENT_THREAD_PRIORITY=10
CONFIG_COAP_CLIENT_MESSAGE_SIZE=1024
CONFIG_COAP_CLIENT_MESSAGE_HEADER_SIZE=64

# CoAP Server
CONFIG_COAP_SERVER=y
CONFIG_COAP_SERVER_WELL_KNOWN_CORE=y
CONFIG_COAP_WELL_KNOWN_BLOCK_WISE=n
```

## src/main.c
```c
/*
 * Copyright (c) 2024 Albin Hjalmas (albin@bitman.se)
 *
 * SPDX-License-Identifier: Apache-2.0
 */

#include <zephyr/kernel.h>
#include <zephyr/logging/log.h>
#include <zephyr/sys/printk.h>
#include <zephyr/sys/byteorder.h>
#include <zephyr/net/socket.h>
#include <zephyr/net/net_mgmt.h>
#include <zephyr/net/conn_mgr_connectivity.h>
#include <zephyr/net/conn_mgr_monitor.h>
#include <zephyr/net/net_ip.h>
#include <zephyr/net/udp.h>
#include <zephyr/net/coap.h>
#include <zephyr/net/coap_client.h>

#include <errno.h>

#include "server_proxy.h"

LOG_MODULE_REGISTER(main, LOG_LEVEL_DBG);

#define PEER_PORT 5683
#define MULTICAST_PORT 5685
#define MESSAGE_INTERVAL K_SECONDS(1)

static const uint16_t LOCAL_COAP_SERVER_PORT = 5684;

static server_proxy_t server_1;
static server_proxy_t local_server;

#include <zephyr/net/coap_service.h>
#include <zephyr/net/net_ip.h>

#ifdef CONFIG_NET_IPV6
#include "ipv6.h"
#include "net_private.h"
#endif

#include "print_service.h"

/**
 * @brief Address for all nodes on the local network segment that support CoAP.
 *
 * @note The specific address being defined here (0xff02::fd) is a reserved
 * multicast address used for CoAP nodes on the local network segment. The
 * 0xff02 at the start of the address indicates that this is a link-local
 * multicast address, meaning it is only intended for devices on the same
 * network segment. The ::fd at the end is the specific identifier for CoAP
 * nodes.
 */
#define ALL_NODES_LOCAL_COAP_MCAST                                                                 \
    {                                                                                              \
        {                                                                                          \
            {                                                                                      \
                0xff, 0x02, 0, 0, 0, 0, 0, 0, 0, 0, 0, 0, 0, 0, 0, 0xfd                            \
            }                                                                                      \
        }                                                                                          \
    }

#define LINE_NODE_MCAST_ADDR                                                                       \
    {                                                                                              \
        {                                                                                          \
            {                                                                                      \
                0xff, 0x02, 0, 0, 0, 0, 0, 0, 0, 0, 0, 0, 0, 0, 0, 0x02                            \
            }                                                                                      \
        }                                                                                          \
    }

static int join_coap_multicast_group(void)
{
    static struct in6_addr my_addr;
    static struct sockaddr_in6 mcast_addr = { .sin6_family = AF_INET6,
                                              .sin6_addr = ALL_NODES_LOCAL_COAP_MCAST,
                                              .sin6_port = htons(LOCAL_COAP_SERVER_PORT) };
    struct net_if_addr *ifaddr;
    struct net_if *iface;
    int ret;

    iface = net_if_get_default();
    if (!iface) {
        LOG_ERR("Could not get the default interface");
        return -ENOENT;
    }

    LOG_DBG("Interface %p", iface);

#if defined(CONFIG_NET_CONFIG_SETTINGS)
    if (net_addr_pton(AF_INET6, CONFIG_NET_CONFIG_MY_IPV6_ADDR, &my_addr) < 0) {
        LOG_ERR("Invalid IPv6 address %s", CONFIG_NET_CONFIG_MY_IPV6_ADDR);
    }
#endif

    ifaddr = net_if_ipv6_addr_add(iface, &my_addr, NET_ADDR_MANUAL, 0);
    if (!ifaddr) {
        LOG_ERR("Could not add unicast address to interface");
        return -EINVAL;
    }

    LOG_DBG("Interface %p addr %p", iface, ifaddr);

    ifaddr->addr_state = NET_ADDR_PREFERRED;

    ret = net_ipv6_mld_join(iface, &mcast_addr.sin6_addr);
    if (ret < 0) {
        LOG_ERR("Cannot join %s IPv6 multicast group (%d)",
                net_sprint_ipv6_addr(&mcast_addr.sin6_addr), ret);
        return ret;
    }

    LOG_DBG("Joined %s IPv6 multicast group", net_sprint_ipv6_addr(&mcast_addr.sin6_addr));

    return 0;
}

static int create_multicast_socket(void)
{
    int sock = -1;
    struct sockaddr_in6 addr = { .sin6_family = AF_INET6,
                                 .sin6_port = htons(MULTICAST_PORT),
                                 .sin6_addr = IN6ADDR_ANY_INIT };

    sock = socket(AF_INET6, SOCK_DGRAM, IPPROTO_UDP);
    if (sock < 0) {
        LOG_ERR("Failed to create socket: %d", errno);
        return -errno;
    }

    if (bind(sock, (struct sockaddr *)&addr, sizeof(addr)) < 0) {
        LOG_ERR("Failed to bind socket: %d", errno);
        close(sock);
        return -errno;
    }

    return sock;
}

// static void send_multicast_message(int sock)
// {
//     struct sockaddr_in6 mcast_addr = {
//         .sin6_family = AF_INET6,
//         .sin6_port = htons(MULTICAST_PORT),
//         .sin6_addr = LINE_NODE_MCAST_ADDR
//     };

//     char payload[128];
//     unsigned int counter = 0;

//     while (1) {
//         snprintf(payload, sizeof(payload), "Hello, World! %d", counter++);
//         int ret = sendto(sock, payload, strlen(payload), 0,
//                          (struct sockaddr *)&mcast_addr, sizeof(mcast_addr));
//         if (ret < 0) {
//             LOG_ERR("Failed to send message: %d", errno);
//         } else {
//             LOG_DBG("Sent multicast message: %s", payload);
//         }

//         k_sleep(MESSAGE_INTERVAL);
//     }
// }

int main(void)
{
    // Join the CoAP multicast group
    LOG_DBG("Joining CoAP multicast group");
    int rc = join_coap_multicast_group();
    if (rc < 0) {
        LOG_ERR("Failed to join CoAP multicast group: %d", rc);
        return rc;
    }

    LOG_DBG("Initializing print service");
    rc = print_service_init();
    if (rc < 0) {
        LOG_ERR("Failed to initialize print service (err %d)", rc);
        return rc;
    }

    LOG_DBG("Connecting to remote CoAP server_1");
    rc = server_proxy_start(&server_1, "2001:db8::1", PEER_PORT);
    if (rc < 0) {
        LOG_ERR("Failed to start CoAP server_1: %d", rc);
        goto exit;
    }

    LOG_DBG("Connecting to local CoAP server");
    rc = server_proxy_start(&local_server, "::1", LOCAL_COAP_SERVER_PORT);
    if (rc < 0) {
        LOG_ERR("Failed to start CoAP local_server: %d", rc);
        goto exit;
    }

    int multicast_sock = 0;
    multicast_sock = create_multicast_socket();
    if (multicast_sock < 0) {
        LOG_ERR("Failed to create multicast socket: %d", multicast_sock);
        goto exit;
    }

    struct sockaddr_in6 mcast_addr = { .sin6_family = AF_INET6,
                                       .sin6_port = htons(MULTICAST_PORT),
                                       .sin6_addr = LINE_NODE_MCAST_ADDR };

    uint8_t payload[128] = "Hello, World! N";

    for (unsigned int i = 0; i < UINT32_MAX; i++) {
        sprintf(payload, "Hello, World! %d To server 1 KUK", i);
        rc = server_proxy_print(&server_1, (const char *)payload, K_MSEC(500));
        if (rc < 0) {
            LOG_ERR("Failed to print message to server_1: %d", rc);
        }

        sprintf(payload, "Hello, World! %d To local server KUK", i);
        rc = server_proxy_print(&local_server, (const char *)payload, K_MSEC(500));
        if (rc < 0) {
            LOG_ERR("Failed to print message to local server: %d", rc);
        }

        snprintf(payload, sizeof(payload), "Hello, World! %d", i);
        int ret = sendto(multicast_sock, payload, strlen(payload), 0,
                         (struct sockaddr *)&mcast_addr, sizeof(mcast_addr));
        if (ret < 0) {
            LOG_ERR("Failed to send multicast message: %d", errno);
        } else {
            LOG_DBG("Sent multicast message: %s", payload);
        }

        k_sleep(K_SECONDS(1));
    }

    LOG_INF("CoAP client done");

exit:
    server_proxy_stop(&server_1);
    close(multicast_sock);
    return rc;
}

COAP_SERVICE_DEFINE(coap_server, NULL, &LOCAL_COAP_SERVER_PORT, COAP_SERVICE_AUTOSTART);
```

## src/coap_client.c
```c
/*
 * Copyright (c) 2024 Albin Hjalmas (albin@bitman.se)
 *
 * SPDX-License-Identifier: Apache-2.0
 */
#include <zephyr/logging/log.h>
#include <zephyr/net/socket.h>

#include <fcntl.h>
#include <errno.h>

#include "coap_client.h"

LOG_MODULE_REGISTER(coap_client, LOG_LEVEL_INF);

int coap_client_start(coap_client_t *client, const char *const peer_addr, uint16_t port)
{
    if (client == NULL || peer_addr == NULL) {
        return -EINVAL;
    }

    int rc = 0;
    struct sockaddr_in6 addr6;

    addr6.sin6_family = AF_INET6;
    addr6.sin6_port = htons(port);
    addr6.sin6_scope_id = 0U;

    inet_pton(AF_INET6, peer_addr, &addr6.sin6_addr);

    client->sock = socket(addr6.sin6_family, SOCK_DGRAM, IPPROTO_UDP);
    if (client->sock < 0) {
        LOG_ERR("Failed to create UDP socket %d", errno);
        return -errno;
    }

    rc = connect(client->sock, (struct sockaddr *)&addr6, sizeof(addr6));
    if (rc < 0) {
        LOG_ERR("Cannot connect to UDP remote : %d", errno);
        return -errno;
    }

    // Set the socket to non-blocking mode.
    // Important when using a UDP socket.
    int flags = fcntl(client->sock, F_GETFL, 0);
    fcntl(client->sock, F_SETFL, flags | O_NONBLOCK);

    // Prepare the pollfd structure.
    // Polling is used to wait for data to be received on the socket.
    client->fds[0].fd = client->sock;
    client->fds[0].events = POLLIN;
    client->nfds = 1;

    return 0;
}

int coap_client_stop(coap_client_t *client)
{
    if (client == NULL) {
        return -EINVAL;
    }

    close(client->sock);

    client->sock = -1;
    client->nfds = 0;

    return 0;
}

int coap_client_put(coap_client_t *client, const char *const *path, const uint8_t *const payload,
                    size_t payload_len)
{
    if (client == NULL || path == NULL || payload == NULL || payload_len == 0) {
        return -EINVAL;
    }

    const size_t MESSAGE_SIZE = CONFIG_COAP_CLIENT_MESSAGE_HEADER_SIZE + payload_len;

    uint8_t *data = (uint8_t *)k_malloc(MESSAGE_SIZE);
    if (!data) {
        return -ENOMEM;
    }

    LOG_DBG("Initializing CoAP packet");

    struct coap_packet request;
    int rc;
    rc = coap_packet_init(&request, data, MESSAGE_SIZE, COAP_VERSION_1, COAP_TYPE_CON,
                          COAP_TOKEN_MAX_LEN, coap_next_token(), COAP_METHOD_PUT, coap_next_id());
    if (rc < 0) {
        LOG_ERR("Failed to initialize CoAP packet: %d", rc);
        goto exit;
    }

    LOG_DBG("Appending URI path to CoAP packet");

    for (const char *const *p = path; p && *p; p++) {
        rc = coap_packet_set_path(&request, *p);
        if (rc < 0) {
            LOG_ERR("Unable add option to request");
            goto exit;
        }
    }

    LOG_DBG("Appending payload marker to CoAP packet");

    rc = coap_packet_append_payload_marker(&request);
    if (rc < 0) {
        LOG_ERR("Failed to append payload marker to CoAP packet: %d", rc);
        goto exit;
    }

    LOG_DBG("Appending payload to CoAP packet");

    rc = coap_packet_append_payload(&request, payload, payload_len);
    if (rc < 0) {
        LOG_ERR("Failed to append payload to CoAP packet: %d", rc);
        goto exit;
    }

    LOG_DBG("Sending CoAP packet");

    ssize_t sent = send(client->sock, request.data, request.offset, 0);
    if (sent < 0) {
        LOG_ERR("Failed to send CoAP packet: %d", errno);
        rc = -errno;
        goto exit;
    }

exit:
    k_free(data);
    return rc;
}

int coap_client_wait_and_receive(coap_client_t *client, struct coap_packet *reply, void *buf,
                                 size_t buf_len, k_timeout_t timeout)
{
    if (client == NULL || buf == NULL) {
        return -EINVAL;
    }

    int rc;
    rc = poll(client->fds, client->nfds, k_ticks_to_ms_ceil32(timeout.ticks));
    if (rc < 0) {
        LOG_ERR("Failed to poll socket: %d", errno);
        return -errno;
    }

    ssize_t received = recv(client->sock, buf, buf_len, 0);
    if (received < 0) {
        LOG_ERR("Failed to receive data: %d", errno);
        return -errno;
    }

    return coap_packet_parse(reply, buf, received, NULL, 0);
}
```

## src/coap_client.h
```c
/*
 * Copyright (c) 2024 Albin Hjalmas (albin@bitman.se)
 *
 * SPDX-License-Identifier: Apache-2.0
 */

#ifndef COAP_CLIENT_H
#define COAP_CLIENT_H

#include <zephyr/net/socket.h>
#include <zephyr/net/coap.h>

#include <stdint.h>
#include <stdbool.h>

typedef struct {
    int sock; // Socket descriptor. Used to send and receive data
    struct pollfd fds[1]; // Polling structure used to wait for data
    int nfds; // Number of file descriptors to poll
} coap_client_t;

/**
 * @brief Initiate and start the specified CoAP client.
 * 
 * @param client The CoAP client to start.
 * @param peer_addr The address of the peer to connect to.
 * @param port The port of the peer to connect to.
 * @return int 0 if successful, otherwise a negative error code.
 */
int coap_client_start(coap_client_t *client, const char *const peer_addr, uint16_t port);

/**
 * @brief Stop the specified CoAP client.
 * 
 * @param client The CoAP client to stop.
 * @return int 0 if successful, otherwise a negative error code.
 */
int coap_client_stop(coap_client_t *client);

/**
 * @brief Send a CoAP PUT request to the specified path.
 * 
 * @param client The CoAP client to use.
 * @param path The path to send the PUT request to.
 * @return int 0 if successful, otherwise a negative error code.
 */
int coap_client_put(coap_client_t *client, const char *const *path, const uint8_t *const payload,
                    size_t payload_len);

/**
 * @brief Wait for a CoAP reply and receive it.
 * 
 * @param client The CoAP client to use.
 * @param reply The CoAP packet to receive the reply into.
 * @param buf Buffer to store the reply in.
 * @param buf_len The length of the buffer.
 * @param timeout The timeout to wait for the reply.
 * @return int 0 if successful, otherwise a negative error code.
 */
int coap_client_wait_and_receive(coap_client_t *client, struct coap_packet *reply, void *buf,
                                 size_t buf_len, k_timeout_t timeout);

#endif // COAP_CLIENT_H
```

## src/print_service.c
```c
/*
 * Copyright (c) 2024 Albin Hjalmas (albin@bitman.se)
 *
 * SPDX-License-Identifier: Apache-2.0
 */

#include <string.h>
#include <zephyr/logging/log.h>
#include <zephyr/net/coap_service.h>
#include <zephyr/net/net_ip.h>

LOG_MODULE_REGISTER(print_service, LOG_LEVEL_DBG);

static int print_put(struct coap_resource *resource, struct coap_packet *request,
                     struct sockaddr *addr, socklen_t addr_len)
{
    const uint8_t *payload;
    uint16_t payload_len;

    LOG_DBG("Received PUT request");

    payload = coap_packet_get_payload(request, &payload_len);
    if (payload_len == 0) {
        LOG_ERR("Invalid payload length");
        return COAP_RESPONSE_CODE_INTERNAL_ERROR;
    }

    LOG_HEXDUMP_DBG(payload, payload_len, "Payload");

    if (strlen(payload) + 1 != payload_len) {
        LOG_ERR("Invalid payload (strlen %zu, payload_len %u)", strlen(payload) + 1, payload_len);
        return COAP_RESPONSE_CODE_INTERNAL_ERROR;
    }

    LOG_INF("Print: %s", payload);

    return COAP_RESPONSE_CODE_CHANGED;
}

static const char *const PRINT_PATH[] = { "print", NULL };
COAP_RESOURCE_DEFINE(print, coap_server, { .put = print_put, .path = PRINT_PATH });

int print_service_init(void)
{
    LOG_INF("Print service initialized");
    return 0;
}
```

## src/print_service.h
```c
/*
 * Copyright (c) 2024 Albin Hjalmas (albin@bitman.se)
 *
 * SPDX-License-Identifier: Apache-2.0
 */
#ifndef PRINT_SERVICE_H
#define PRINT_SERVICE_H

int print_service_init(void);

#endif // PRINT_SERVICE_H
```

## src/server_proxy.c
```c
#include <zephyr/kernel.h>

#include "server_proxy.h"

static uint8_t sketch[CONFIG_COAP_CLIENT_MESSAGE_HEADER_SIZE + CONFIG_COAP_CLIENT_MESSAGE_SIZE];

int server_proxy_start(server_proxy_t *proxy, const char *const peer_addr, uint16_t port)
{
    return coap_client_start(&proxy->client, peer_addr, port);
}

int server_proxy_stop(server_proxy_t *proxy)
{
    return coap_client_stop(&proxy->client);
}

int server_proxy_print(server_proxy_t *proxy, const char *const message, k_timeout_t timeout)
{
    static const char *const PATH[] = { "print", NULL };
    int rc = coap_client_put(&proxy->client, PATH, (const uint8_t *)message, strlen(message) + 1);
    if (rc < 0) {
        return rc;
    }

    struct coap_packet reply;
    rc = coap_client_wait_and_receive(&proxy->client, &reply, sketch, sizeof(sketch), timeout);
    if (rc < 0) {
        return rc;
    }

    if (coap_header_get_code(&reply) != COAP_RESPONSE_CODE_CHANGED) {
        return -EIO;
    }

    return 0;
}
```

## src/server_proxy.h
```c
/*
 * Copyright (c) 2024 Albin Hjalmas (albin@bitman.se)
 *
 * SPDX-License-Identifier: Apache-2.0
 */

#ifndef SERVER_PROXY_H
#define SERVER_PROXY_H

#include "coap_client.h"

typedef struct {
    coap_client_t client;
} server_proxy_t;

/**
 * @brief Initiate and start the specified server proxy.
 * 
 * @param proxy The server proxy to start.
 * @param peer_addr The address of the peer to connect to.
 * @param port The port of the peer to connect to.
 * @return int 0 if successful, otherwise a negative error code.
 */
int server_proxy_start(server_proxy_t *proxy, const char *const peer_addr, uint16_t port);

/**
 * @brief Stop the specified server proxy.
 * 
 * @param proxy The server proxy to stop.
 * @return int 0 if successful, otherwise a negative error code.
 */
int server_proxy_stop(server_proxy_t *proxy);

/**
 * @brief Print the specified message using the server proxy.
 * 
 * @param proxy The server proxy to use.
 * @param message The message to print.
 * @param timeout The timeout for the operation.
 * @return int 0 if successful, otherwise a negative error code.
 */
int server_proxy_print(server_proxy_t *proxy, const char *const message, k_timeout_t timeout);

#endif // SERVER_PROXY_H
```
